## CusTJ/Kconfig.defconfig
```kconfig
if SHIELD_CUSTJ_LEFT

config ZMK_KEYBOARD_NAME
	default "CusTJ"

config ZMK_SPLIT_ROLE_CENTRAL
	default y

endif

if SHIELD_CUSTJ_LEFT || SHIELD_CUSTJ_RIGHT

config ZMK_SPLIT
	default y

endif
```

## CusTJ/Kconfig.shield
```kconfig
# Copyright (c) 2020 Pete Johanson
# SPDX-License-Identifier: MIT

config SHIELD_CUSTJ
	def_bool $(shields_list_contains,CusTJ)

config SHIELD_CUSTJ_LEFT
	def_bool $(shields_list_contains,CusTJ_left)

config SHIELD_CUSTJ_RIGHT
	def_bool $(shields_list_contains,CusTJ_right)
```
